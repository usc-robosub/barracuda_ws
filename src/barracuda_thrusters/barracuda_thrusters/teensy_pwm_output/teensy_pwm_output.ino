#include <Arduino.h>
#include <i2c_register_slave.h>

// defines teensy configs, generated by update_header.py, which uses
// ..teensys.Teensy class as source of truth for pwm config vals and I2C
// address vals. this approach is used so we have pwm config vals defined
// in and derived from a single source
#include "teensy_config.h"

// for blink delays (for indicating whether or not thrusters are enabled)
#define SHORT_DELAY 250
#define LONG_DELAY 1000

#ifdef PORT
#define DC_START_IDX 0
#define I2C_ADDR (PORT_I2C_ADDR)
#endif

#ifdef STARBOARD
#define DC_START_IDX (N_PWM_PINS) /* N_PWM_PINS defined in header */
#define I2C_ADDR (STARBOARD_I2C_ADDR)
#endif

struct Registers {
  // duty cycle vals
  // four  16-bit uints take up 8 bytes
  // using 16-bit uint to accomodate higher pwm bit res (currently 8 bits)
  uint16_t dcs[N_PWM_PINS] = {0};

  // "enable" reg
  // one 8-bit uint takes up 1 byte
  uint8_t enable = 0;

} registers;

// only using read-write registers, no read only registers
I2CRegisterSlave register_slave = I2CRegisterSlave(
    Slave1, (uint8_t*)&registers, sizeof(registers), nullptr, 0);

// flag used to avoid accessing enabled register value outside of its dedicated
// case in on_write_isr
volatile bool enabled_flag = false;

// flag to keep track of when zero force is outputted for all thrusters (used in
// delay expr)
volatile bool zero_force_output_flag = true;

// flag set when i2c regs are written to
volatile bool written_flag = false;

void on_write_isr(uint8_t reg, size_t n_bytes) {
  written_flag = true;
  switch (reg) {
  case ENABLE_REG:
    // output reset pulse on all pwm pins
    // we need to reinit the thrusters on opening and/or closing of the
    // killswitch latch
    for (int i = 0; i < N_PWM_PINS; i++) {
      // set registers.dcs[i] to INIT_DC
      analogWrite(PWM_PINS[i], registers.dcs[i] = INIT_DC);
    }
    if (registers.enable == 1) {
      enabled_flag = true;
    } else {
      enabled_flag = false;
    }
    break;

  case DCS_REG:
    // update pwm outputs if thrusters are enabled
    if (registers.enable == 1) {
      bool zero_force_output = true;
      for (int i = 0; i < N_PWM_PINS; i++) {
        if (registers.dcs[i] != INIT_DC) {
          zero_force_output = false;
        }
        analogWrite(PWM_PINS[i], registers.dcs[i]);
      }
      zero_force_output_flag = zero_force_output;
    }
    break;
  }
}

void setup() {
  pinMode(LED_BUILTIN, OUTPUT);
  Serial.begin(9600);

  /* i2c setup */
  register_slave.listen(I2C_ADDR);
  register_slave.after_write(on_write_isr);

  /* pwm setup */
  analogWriteResolution(PWM_RES);
  for (int i = 0; i < N_PWM_PINS; i++) {
    analogWriteFrequency(PWM_PINS[i], PWM_FREQ);
  }
}

void loop() {
  // blink faster if regular pwm output is enabled and nonzero, keep led on with
  // no blink if enabled and all zero, blink slower if disabled
  noInterrupts();
  int blink_delay =
      (enabled_flag == true)
          ? ((zero_force_output_flag == true) ? (0) : (SHORT_DELAY))
          : (LONG_DELAY);
  Registers registers_snapshot = registers;
  interrupts();

  // might miss writes that happen during the printing - using below for debugging so write frequency will be low,
  // likely won't be an issue
  if (written_flag == true) {
    Serial.print("enable byte: ");
    Serial.println(registers_snapshot.enable);
    Serial.println("dcs: ");
    for (int i = 0; i < N_PWM_PINS; i++) {
      Serial.println(registers_snapshot.dcs[i]);
    }
    written_flag = false;
  }

  digitalWrite(LED_BUILTIN, HIGH);
  delay(blink_delay);
  digitalWrite(LED_BUILTIN, LOW);
  delay(blink_delay);
}
